//
// Created by Fir on 2024/3/7 007.
//

#include <vector>
#include "astra_logo.h"
#include "astra_rocket.h"

#include "GYRO_app.h"


std::vector<uint8_t> Compass = {
    0xff, 0xff, 0xff, 0xff, 0xff, 0xef, 0xff, 0xff, 0xff, 0xcf, 0xff, 0xff, 0xff, 0xcf, 0xff, 0xff, 0xff, 0x07, 0xf0, 0xff, 0xff, 0x03, 0xe0, 0xff,
    0xff, 0xe1, 0xc7, 0xff, 0xff, 0x30, 0x9c, 0xff, 0x7f, 0x18, 0x30, 0xff, 0x3f, 0x0c, 0xe0, 0xff, 0x3f, 0xce, 0xe1, 0xff, 0x3f, 0xee, 0xc3, 0xff,
    0x1f, 0xef, 0xc7, 0xff, 0x1f, 0xff, 0x87, 0xf0, 0x1f, 0xff, 0x87, 0xf1, 0x1f, 0x07, 0xfc, 0xf1, 0x1f, 0x03, 0x3c, 0xf8, 0x1f, 0x8f, 0x07, 0xfe,
    0x1f, 0xff, 0xc0, 0xff, 0x0f, 0x06, 0xf8, 0xff, 0x0f, 0x06, 0xcf, 0xfd, 0x3f, 0xfc, 0xc7, 0xfc, 0x7f, 0x78, 0x43, 0xfe, 0xff, 0x70, 0x60, 0xfe,
    0xff, 0xe0, 0x11, 0xff, 0xff, 0xc1, 0x8f, 0xff, 0xff, 0x07, 0xc0, 0xff, 0xff, 0x0f, 0xe0, 0xff, 0xff, 0xff, 0xf3, 0xff, 0xff, 0xff, 0xf7, 0xff,
    0xff, 0xff, 0xff, 0xff, 0xff, 0xff, 0xff, 0xff,
};




std::vector<uint8_t> Photo = {
    0xff, 0xff, 0xff, 0xff, 0xff, 0xff, 0xff, 0xff, 0xff, 0xff, 0xff, 0xff, 0x7f, 0x00, 0x00, 0xf0,
    0x3f, 0xff, 0xff, 0xe3, 0x9f, 0xff, 0xff, 0xe7, 0x9f, 0xff, 0xff, 0xef, 0x07, 0x00, 0xc0, 0xef,
    0x03, 0x00, 0x00, 0x6f, 0xf9, 0xff, 0x3f, 0x6f, 0xfd, 0xff, 0x7f, 0x6e, 0x1d, 0xff, 0x7f, 0x6e,
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    0xff, 0xff, 0xff, 0xff, 0xff, 0xff, 0xff, 0x3f

};

std::vector<uint8_t> Setting = {
    0xFF, 0xFF, 0xFF, 0x3F, 0xFF, 0xFF, 0xFF, 0x3F, 0xFF, 0xFF, 0xFF, 0x3F, 0xFF, 0xFF, 0xFF, 0x3F,
    0xFF, 0x1F, 0xFE, 0x3F, 0xFF, 0x1F, 0xFE, 0x3F, 0xFF, 0x0C, 0xCC, 0x3F, 0x7F, 0x00, 0x80, 0x3F,
    0x3F, 0x00, 0x00, 0x3F, 0x3F, 0xE0, 0x01, 0x3F, 0x7F, 0xF8, 0x87, 0x3F, 0x7F, 0xFC, 0x8F, 0x3F,
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    0xFF, 0xFF, 0xFF, 0x3F, 0xFF, 0xFF, 0xFF, 0x3F
};

std::vector<uint8_t> Camera ={
    0xff, 0xff, 0xff, 0xff, 0xff, 0xff, 0xff, 0xff, 0xff, 0xff, 0xff, 0xff, 0xff, 0xff, 0xff, 0xff,
    0xff, 0xff, 0xff, 0xff, 0xff, 0xff, 0xff, 0xff, 0xff, 0x07, 0xf8, 0xff, 0xff, 0x03, 0xf0, 0xff,
    0xff, 0x00, 0xc0, 0xff, 0x1f, 0x00, 0x00, 0xfc, 0x0f, 0x00, 0x00, 0xfc, 0x0f, 0xc0, 0x41, 0xfc,
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    0xff, 0xff, 0xff, 0xff, 0xff, 0xff, 0xff, 0x3f

};



std::vector<uint8_t> WIFI = {
    0xff, 0xff, 0xff, 0xff, 0xff, 0x07, 0xe0, 0xff, 0xff, 0x01, 0x80, 0xff, 0x7f, 0x00, 0x00, 0xfe,
    0x3f, 0x00, 0x00, 0xfc, 0x1f, 0xf0, 0x0f, 0xf8, 0x0f, 0xfc, 0x3f, 0xf0, 0x07, 0xff, 0xff, 0xe0,
    0xc3, 0x0f, 0xf0, 0xc3, 0xc1, 0x03, 0xc0, 0x83, 0xe1, 0x01, 0x80, 0x87, 0xf1, 0x80, 0x03, 0xcf,
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    0xff, 0x3f, 0xfc, 0xff, 0xff, 0xff, 0xff, 0xff
};


void System_StartAnimation(void) {
    HAL::delay(1000);
    HAL::printInfo("System starting...");
    HAL::delay(500);
    HAL::printInfo("System finish Init... ");
    HAL::delay(500);
    HAL::printInfo("AstraUI is getting ready ");
    HAL::delay(500);
    HAL::printInfo("AstraUI Starting!!!");
    HAL::delay(1000);
    // 清除之前的信息显示
    HAL::canvasClear();
    HAL::canvasUpdate();
    // 获取屏幕配置
    const auto& screenConfig = HAL::getSystemConfig();
    const float radius = astra::getUIConfig().popRadius;  // 从配置获取圆角半径（如2px）
    // 加载条配置
    const int barWidth = static_cast<int>(screenConfig.screenWeight * 0.8f);  // 屏幕80%宽度
    const int barHeight = 10;                                                // 固定高度10px
    const int barX = (screenConfig.screenWeight - barWidth) / 2;             // 水平居中
    const int barY = screenConfig.screenHeight / 2;                          // 垂直居中
    // 加载文字配置
    std::string loadText = "Loading...";
    uint8_t textWidth = HAL::getFontWidth(loadText);
    float textX = (screenConfig.screenWeight - textWidth) / 2.0f;
    float textY = barY - 12;  // 文字在加载条上方12px
    // 绘制静态元素（文字和边框只画一次）
    HAL::setDrawType(1);  // 实心模式绘制文字
    HAL::drawEnglish(textX, textY, loadText);
    HAL::setDrawType(1);  // 空心模式绘制边框
    HAL::drawRFrame(barX, barY, barWidth, barHeight, static_cast<uint8_t>(radius));  // 圆角边框用整数半径
    // 动态加载进度（每次刷新前清除上一次的填充）
    for (int i = 0; i <= 100; i += 5) {
        // 计算当前进度宽度（确保至少为0）
        int progressWidth = std::max(0, (barWidth - 2) * i / 100);
        // 清除上一次的填充区域（关键修复：避免填充叠加）
        HAL::setDrawType(0);  // 用背景色清除（假设实色为背景色）
        HAL::drawRBox(barX + 1, barY + 1, barWidth - 2, barHeight - 2, static_cast<uint8_t>(radius - 1));
        // 绘制新的进度填充（圆角半径比边框小1px，避免重叠）
        if (progressWidth > 0) {  // 进度为0时不绘制
            HAL::setDrawType(1);  // 用前景色填充（反色模式，与边框区分）
            HAL::drawRBox(barX + 1, barY + 1, progressWidth, barHeight - 2, static_cast<uint8_t>(radius - 1));
        }


        // 更新显示
        HAL::canvasUpdate();

        // 控制动画速度（总时长约1秒）
        HAL::delay(50);

    }

    HAL::canvasClear();
    HAL::setDrawType(1); // 确保设置为正常绘制模式
    HAL::canvasUpdate();
    astra::drawLogo(100);
}



auto *astraLauncher = new astra::Launcher();
auto *rootPage = new astra::Tile("root");
auto *Settings = new astra::List("Setting",Setting);
auto *MyCamera = new astra::List("Camera",Camera);
//auto* About = new astra::List("-About");      // About子菜单
astra::SerialMonitor* g_serialMonitor = new astra::SerialMonitor("SerialMonitor");
//astra::SerialMonitor* g_serialMonitor2 = new astra::SerialMonitor("SerialMonitor");
astra::Clock* MyClock = new astra::Clock("Timer");
astra::HardwareInfo* About = new astra::HardwareInfo("<About>"); // 列表中显示的项名
astra::Weather* Myweather = new astra::Weather("Weather");
astra::WiFi* MyWiFi = new astra::WiFi("WiFi");
astra::GYRO* MyGyro = new astra::GYRO("GYRO");
void MySerialMonitorUpdate() {
    //处理真实UART数据
    if (Uart1_flag == 1) { // 检测到UART1接收完成
        // 确保SerialMonitor活跃（isActive为true，避免未初始化时传数据）
        if (g_serialMonitor->isActive) {
            // 调用SerialMonitor的addData方法，传入接收数据和长度
            g_serialMonitor->addData(receiveData, receiveDatasize);
        }
        //重置状态：避免重复处理数据
        Uart1_flag = 0;                  // 重置接收标志
        receiveDatasize = 0;             // 重置接收长度
        memset(receiveData, 0, 50);      // 清空接收数组，准备下次接收
    }
}
//
bool checkBox_Value = false;
astra::CheckBox* checkBox = new astra::CheckBox(checkBox_Value);
unsigned char ScreenPopUp_Value = 0;
Widget_Selector widget_selector = Widget_Selector_NoSelect;
astra::PopUp*ScreenPopUp =  new astra::PopUp(1, "Screenmode", {"Light", "Dark"}, ScreenPopUp_Value);
unsigned char BrightnessSlider_Value = 200;
astra::Slider*slider = new astra::Slider("Brightness", 0, 200, 2, BrightnessSlider_Value);





void astraCoreInit(void) {

    HAL::inject(new Myhal);

    unsigned long bootStartTime = HAL::millis(); // 步骤1添加的起始时间

    System_StartAnimation();

    unsigned long bootTime = (HAL::millis() - bootStartTime)*0.001;
    std::string bootTimeStr = "Start-up time:" + std::to_string(bootTime) + "s";


    rootPage->addItem(Settings);
    rootPage->addItem(g_serialMonitor);
    rootPage->addItem(MyWiFi);
    rootPage->addItem(MyClock);
    rootPage->addItem(Myweather);
    rootPage->addItem(MyGyro);

    rootPage->addItem(MyCamera);
    rootPage->addItem(new astra::Tile("Photo",Photo));



    MyCamera->addItem(new astra::List("-test0"));

    Settings->addItem(About);

    Settings->addItem(new astra::List("-Brightness"),slider);
    Settings->addItem(new astra::List("-RGBLed"), checkBox);
    Settings->addItem(new astra::List("-ScreenMode"),ScreenPopUp);


    Settings->addItem(new astra::List("-test5"));
    Settings->addItem(new astra::List("-test5"));
    Settings->addItem(new astra::List("-test5"));
    Settings->addItem(new astra::List("-test5"));
    Settings->addItem(new astra::List("-test5"));


    astraLauncher->init(rootPage);
    astraLauncher->popInfo(bootTimeStr, 200);

}



//主程序入口
void CppMain(void) {

    //HAL::wifiConnect("Wi-Fi","chuang123.");
    // esp8266_start_trans("Wi-Fi","chuang123."); 								//esp8266进行初始化，连接wifi
    // get_current_weather();
    // get_current_Time();

    for(;;) {


        //esp8266_Connect("Wi-Fi", "chuang123.");
        ws2812_Updata();

        MySerialMonitorUpdate();
        astraLauncher->update();
    }
}